## src/buildroot/2010.11_overlay/package/elecard/Config.in
```kconfig
menu "Elecards packages"
source "package/elecard/lirc/Config.in"
source "package/elecard/compat-wireless/Config.in"
source "package/elecard/linuxtv-dvb-apps/Config.in"
source "package/elecard/pcsc-lite/Config.in"
source "package/elecard/ccid/Config.in"

source "package/elecard/updater/Config.in"

source "package/elecard/stapisdk/Config.in"
source "package/elecard/stmfb/Config.in"
source "package/elecard/rootfs-apps/Config.in"

source "package/elecard/modules/Config.in"
source "package/elecard/modules-elecard/Config.in"

source "package/elecard/commonlib/Config.in"
source "package/elecard/xl2tpd/Config.in"
endmenu
```

## src/buildroot/2010.11_overlay/package/elecard/accel-pptp/Config.in
```kconfig
config BR2_PACKAGE_ACCEL_PPTP
	bool "accel-pptp"
	select BR2_PACKAGE_PPPD
	help
	  The PPTP client and server for Linux.

	  ACCEL-PPTP uses kernel module to increase performance
	  and decrease system usage.

	  http://accel-pptp.sourceforge.net/
```

## src/buildroot/2010.11_overlay/package/elecard/backports/Config.in
```kconfig
config BR2_PACKAGE_BACKPORTS
	bool "backported linux drivers"
	help
	  Backports provide drivers released on newer kernels backported
	  for usage on older kernels.
	  See https://backports.wiki.kernel.org/index.php/Main_Page
```

## src/buildroot/2010.11_overlay/package/elecard/ccid/Config.in
```kconfig
config BR2_PACKAGE_CCID
	bool "ccid"
	select BR2_PACKAGE_PKG_CONFIG
	select BR2_PACKAGE_LIBUSB
	select BR2_PACKAGE_PCSC_LITE
	help
	  This package provides the source code for a generic USB CCID 
	  (Chip/Smart Card Interface Device) driver and ICCD (Integrated Circuit(s) Card Devices)
	  
	  For more information, please visit the project page: 
	  http://pcsclite.alioth.debian.org/ccid.html

	  List of supported hardware:
	  http://pcsclite.alioth.debian.org/ccid/section.html
```

## src/buildroot/2010.11_overlay/package/elecard/compat-wireless/Config.in
```kconfig
config BR2_PACKAGE_COMPAT_WIRELESS
	bool "compat-wireless"
	help
	  Stable kernel compat-wireless driver package.
```

## src/buildroot/2010.11_overlay/package/elecard/encfs/Config.in
```kconfig
config BR2_PACKAGE_ENCFS
	bool "encfs"
	depends on BR2_PACKAGE_BOOST
	depends on BR2_PACKAGE_RLOG
	depends on BR2_PACKAGE_LIBFUSE

	help
	EncFS provides an encrypted filesystem in user-space. It runs without any special permissions and uses the FUSE library module to provide the filesystem interface. EncFS is open source software, licensed under the GPL (with the underlying library released under the LGPL).

	https://vgough.github.io/encfs/
	http://www.arg0.net/encfs	
	http://encfs.googlecode.com/files/encfs-1.7.4.tgz
```

## src/buildroot/2010.11_overlay/package/elecard/frontpanel/Config.in
```kconfig
config BR2_PACKAGE_FRONTPANEL
	bool "frontpanel"
	default n
	help
	  Frontpanel daemon.
```

## src/buildroot/2010.11_overlay/package/elecard/linuxtv-dvb-apps/Config.in
```kconfig
config BR2_PACKAGE_LINUXTV_DVB_APPS
	bool "linuxtv-dvb-apps libraries"
	default n
	help
		http://www.linuxtv.org

config BR2_PACKAGE_LINUXTV_DVB_APPS_TOOLS
	bool "Install dvb tools"
	depends on BR2_PACKAGE_LINUXTV_DVB_APPS
	default n
```

## src/buildroot/2010.11_overlay/package/elecard/linuxtv/Config.in
```kconfig
config BR2_PACKAGE_LINUXTV
	bool "The LinuxTV project"
	default n
	help
	  The LinuxTV project develops and maintains the media driver Linux Kernel Subsystems, which consists of devices for webcams, analog TV, digital TV and remote controllers.
```

## src/buildroot/2010.11_overlay/package/elecard/lirc/Config.in
```kconfig
config BR2_PACKAGE_LIRC
	bool "lirc"
	help
          LIRC is a package that supports receiving and sending IR
          signals of the most common IR remote controls. It contains a
          daemon that decodes and sends IR signals, a mouse daemon
          that translates IR signals to mouse movements and a couple
          of user programs that allow to control your computer with a
          remote control.

          A list of supported hardware is available on the main page.

	  http://www.lirc.org/

if BR2_PACKAGE_LIRC

choice
	prompt "lirc drivers"
	default BR2_PACKAGE_LIRC_ALL

	help
	  Select the drivers to build in lirc. There is 3 choices, all
	  of them, one of them, none of them. By selecting 'one of
	  them', you will have to select which one in the next item.

	config BR2_PACKAGE_LIRC_ALL
		bool "all"

	config BR2_PACKAGE_LIRC_USERSPACE
		bool "userspace"

	config BR2_PACKAGE_LIRC_STM
		bool "stm"

	config BR2_PACKAGE_LIRC_NONE
		bool "none"
endchoice

endif # BR2_PACKAGE_LIRC
```

## src/buildroot/2010.11_overlay/package/elecard/modules-elecard/Config.in
```kconfig
config BR2_PACKAGE_MODULES_ELECARD
	bool "Elecard modules, private"
	help
	  st_dvb.
```

## src/buildroot/2010.11_overlay/package/elecard/modules/Config.in
```kconfig
config BR2_PACKAGE_ELECARD_MODULES
	bool "Elecard modules"
	help
	  Elecard STB830 modules.

config BR2_PACKAGE_ELECARD_MODULES_PRIV
	bool "Elecard modules, private part"
	help
	  mxl201.
```

## src/buildroot/2010.11_overlay/package/elecard/pcsc-lite/Config.in
```kconfig
config BR2_PACKAGE_PCSC_LITE
	bool "pcsc-lite"
	select BR2_PACKAGE_LIBUSB
	help
	  Middleware to access a smart card using SCard API (PC/SC).
	  For more information, please visit:
	  http://pcsclite.alioth.debian.org/pcsclite.html
```

## src/buildroot/2010.11_overlay/package/elecard/pure-ftpd/Config.in
```kconfig
config BR2_PACKAGE_PURE_FTPD
	bool "Pure-FTPd"
	default n
	help
	  Pure-FTPd is a free (BSD), secure, production-quality and standard-conformant FTP server.
	  http://www.pureftpd.org/project/pure-ftpd
```

## src/buildroot/2010.11_overlay/package/elecard/rlog/Config.in
```kconfig
config BR2_PACKAGE_RLOG
	bool "rlog"
	help
	  RLog provides a flexible message logging facility for C++ programs and libraries. It is subscription based, meaning you can subscribe to messages of your choice in an number of ways: by hierarchical channel name (e.g. "debug", "debug/special", "error", etc.), or filename, component name, etc. 

	  http://code.google.com/p/rlog/
```

## src/buildroot/2010.11_overlay/package/elecard/rootfs-apps/Config.in
```kconfig
config BR2_PACKAGE_ROOTFS_APPS
	bool "rootfs apps"
	help
	  Rootfs applications.
```

## src/buildroot/2010.11_overlay/package/elecard/stmfb/Config.in
```kconfig
config BR2_PACKAGE_STMFB
	bool "stmfb"
	default n
	help
	  Simple framebuffer driver for STMicroelectronics SoCs.
	  stlinux24-host-stmfb-source and stlinux24-sh4-stmfb-firmware
	  must be installed.

config BR2_PACKAGE_STMFB_LOGO
	bool "Elecard boot logo"
	default y
	depends on BR2_PACKAGE_STMFB
```

## src/buildroot/2010.11_overlay/package/elecard/updater/Config.in
```kconfig
config BR2_PACKAGE_UPDATER_HWCONFIG
	bool "hwconfigManager"
	help
	  Elecards hwconfigManager.

config BR2_PACKAGE_UPDATER
	bool "updater"
	select BR2_PACKAGE_UPDATER_HWCONFIG
	help
	  Elecards updater.


config BR2_PACKAGE_UPDATER_USE_HTTP
	bool "http support"
	depends on BR2_PACKAGE_UPDATER
	depends on BR2_PACKAGE_LIBCURL
	help
	  Support update via http.


config BR2_PACKAGE_UPDATER_USE_SSL
	bool "ssl support"
	depends on BR2_PACKAGE_UPDATER
	depends on BR2_PACKAGE_OPENSSL
	help
	  Support update with checking signatures.
```

## src/buildroot/2010.11_overlay/package/elecard/xl2tpd/Config.in
```kconfig
config BR2_PACKAGE_XL2TPD
	bool "xl2tpd"
	select BR2_PACKAGE_LIBPCAP
	help
	  Layer 2 Tunnelling Protocol (RFC2661).

	  xl2tpd is an open source implementation of the L2TP tunneling
	  protocol. xl2tpd is forked from l2tpd and is maintained by
	  Xelerance Corporation.

	  http://www.xelerance.com/software/xl2tpd/
```
